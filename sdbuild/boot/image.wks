## sdbuild/boot/image.wks
```
# Description: Creates a partitioned SD card image. Boot files
# are located in the first vfat partition. Rootfs will be in second ext4 partition.

part /boot --source bootimg-partition --ondisk mmcblk0 --fstype=vfat --label PYNQ --active --align 4 --size 100 --overhead-factor=1
part / --source rootfs --ondisk mmcblk0 --fstype=ext4 --label root --align 1024 --extra-space 512
```

## sdbuild/boot/image_arm.its
```
/dts-v1/;
 
/ {
    description = "U-Boot fitImage for PYNQ arm kernel";
    #address-cells = <1>;
 
    images {
        kernel@0 {
            description = "Linux Kernel";
            data = /incbin/("./zImage");
            type = "kernel";
            arch = "arm";
            os = "linux";
            compression = "none";
            load = <0x80000>;
            entry = <0x80000>;
            hash@1 {
                algo = "sha1";
            };
        };
        fdt@0 {
            description = "Flattened Device Tree blob";
            data = /incbin/("./system.dtb");
            type = "flat_dt";
            arch = "arm";
            compression = "none";
            hash@1 {
                algo = "sha1";
            };
        };
    };
    configurations {
        default = "conf@1";
        conf@1 {
            description = "Boot Linux kernel with FDT blob";
            kernel = "kernel@0";
            fdt = "fdt@0";
            hash@1 {
                algo = "sha1";
            };
        };
    };
};
```

## sdbuild/boot/meta-pynq/conf/layer.conf
```bitbake
# We have a conf and classes directory, add to BBPATH
BBPATH .= ":${LAYERDIR}"

# We have recipes-* directories, add to BBFILES
BBFILES += "${LAYERDIR}/recipes-*/*/*.bb \
	${LAYERDIR}/recipes-*/*/*.bbappend"

BBFILE_COLLECTIONS += "pynq"
BBFILE_PATTERN_pynq = "^${LAYERDIR}/"
BBFILE_PRIORITY_pynq = "6"

LAYERSERIES_COMPAT_pynq = "zeus"
```
